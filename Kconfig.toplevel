## components/buzzer/Kconfig
```kconfig
menu "Buzzer Configuration"

config BUZZER_ENABLE
    bool "Enable Buzzer"
    default y
    help
      Enable this option to include the buzzer component in your project.
      This allocates a GPIO pin and PWM timer. Disable to save resources.

config BUZZER_GPIO
    int "GPIO pin for buzzer"
    depends on BUZZER_ENABLE
    default 13
    help
      Specify the GPIO pin number to be used for the buzzer's PWM output.
      Ensure this pin is not in use by any other component.

config BUZZER_FREQ
    int "Buzzer frequency (Hz)"
    depends on BUZZER_ENABLE
    default 2000
    help
      Set the frequency of the PWM signal. For a passive buzzer, this value
      determines the pitch. For an active buzzer, a value in the 1-5 kHz
      range is recommended to avoid audible buzzing artifacts.

config BUZZER_DUTY
    int "LEDC duty (0-8191)"
    depends on BUZZER_ENABLE
    default 4095
    help
      Set the duty cycle for the PWM signal. The value is based on the 13-bit
      resolution of the LEDC timer. A value of 4095 results in a 50% duty cycle.

endmenu
```

## components/comm/Kconfig
```kconfig
menu "Communication Configuration"

    menu "UART Settings"
        config UART_PORT_NUM
            int "UART Port Number"
            range 0 2
            default 1
            help
                UART port number (0=UART0, 1=UART1, 2=UART2)

        config UART_TX_PIN
            int "UART TX GPIO"
            range 0 33
            default 17
            help
                GPIO for UART transmission

        config UART_RX_PIN
            int "UART RX GPIO"
            range 0 33
            default 16
            help
                GPIO for UART reception

        config UART_BAUD_RATE
            int "UART Baud Rate"
            default 115200
            help
                Communication speed in bits per second
    endmenu

    menu "I2C Settings"
        config I2C_PORT_NUM
            int "I2C Port Number"
            range 0 1
            default 0
            help
                I2C port number (0=I2C_NUM_0, 1=I2C_NUM_1)

        config I2C_SDA_PIN
            int "I2C SDA GPIO"
            range 0 33
            default 21
            help
                GPIO for I2C data line

        config I2C_SCL_PIN
            int "I2C SCL GPIO"
            range 0 33
            default 22
            help
                GPIO for I2C clock line

        config I2C_CLOCK_SPEED
            int "I2C Clock Speed (Hz)"
            default 400000
            help
                I2C communication frequency

        config I2C_DEVICE_ADDR
            hex "Default I2C Device Address"
            default 0x68
            help
                7-bit I2C device address (without R/W bit)
    endmenu

    menu "GPIO Settings"
        config DEFAULT_LED_GPIO
            int "Default LED GPIO"
            range 0 33
            default 2
            help
                GPIO for status LED

        config DEFAULT_BUTTON_GPIO
            int "Default Button GPIO"
            range 0 33
            default 0
            help
                GPIO for input button
    endmenu

endmenu
```

## components/debugs/Kconfig
```kconfig
menu "Debug and Logging System (debugs)"

config DEBUGS_ENABLE_LOG
    bool "Enable logging macros"
    default y
    help
        Enable or disable all DEBUGS_LOGx macros globally.
        Disabling this will strip all debug logging at compile-time.

config DEBUGS_ENABLE_PERIODIC_LOG
    bool "Enable periodic logging task"
    default y
    depends on DEBUGS_ENABLE_LOG
    help
        Enables a FreeRTOS task that periodically prints debug/logging output.
        Useful for monitoring system status at regular intervals.

config DEBUGS_LOG_INTERVAL_MS
    int "Periodic log interval (ms)"
    default 5000
    depends on DEBUGS_ENABLE_PERIODIC_LOG
    range 100 60000
    help
        Interval in milliseconds between periodic log prints.

config DEBUGS_TASK_STACK_SIZE
    int "Debug task stack size (bytes)"
    default 2048
    depends on DEBUGS_ENABLE_PERIODIC_LOG
    range 512 8192
    help
        Stack size allocated for the periodic debug task.

config DEBUGS_TASK_PRIORITY
    int "Debug task priority"
    default 5
    depends on DEBUGS_ENABLE_PERIODIC_LOG
    range 1 20
    help
        Task priority of the periodic debug task.

endmenu
```

## components/fall_logic/Kconfig
```kconfig
menu "Fall Detection Logic Configuration"

config FALL_LOGIC_ENABLE
    bool "Enable fall detection logic"
    default y
    help
        Enable or disable the fall detection functionality.
        When enabled, the system will periodically analyze
        accelerometer data to detect possible falls.

config FALL_LOGIC_THRESHOLD_G
    int "Fall detection threshold (mg)"
    default 400
    range 100 800
    depends on FALL_LOGIC_ENABLE
    help
        The acceleration threshold in milli-g (mg) used to
        identify a fall event. A value of 400mg (0.4g) is a
        good default. During freefall, total acceleration drops
        significantly, typically near 0g.

config FALL_LOGIC_CHECK_INTERVAL_MS
    int "Sensor polling interval (ms)"
    default 150
    range 50 500
    depends on FALL_LOGIC_ENABLE
    help
        The interval in milliseconds between sensor checks.
        Shorter intervals increase responsiveness but use more CPU.
        Default is 150ms for a good balance.

config FALL_LOGIC_TASK_STACK_SIZE
    int "Fall logic task stack size (bytes)"
    default 4096
    depends on FALL_LOGIC_ENABLE
    help
        Stack size for the FreeRTOS task responsible for
        processing fall detection logic.

config FALL_LOGIC_TASK_PRIORITY
    int "Fall logic task priority"
    default 5
    depends on FALL_LOGIC_ENABLE
    help
        Priority of the FreeRTOS task handling fall detection.
        Higher values increase task precedence over others.

endmenu
```

## components/led_indicator/Kconfig
```kconfig
menu "LED Indicator Configuration"

config LED_INDICATOR_ENABLE
    bool "Enable LED Indicator"
    default y

config LED_INDICATOR_GPIO
    int "GPIO number for LED"
    depends on LED_INDICATOR_ENABLE
    default 2
    help
        GPIO number where the LED is connected.

config LED_INDICATOR_ACTIVE_HIGH
    bool "LED is active high?"
    depends on LED_INDICATOR_ENABLE
    default y
    help
        If set, a logic high level will turn the LED on.

config LED_INDICATOR_TASK_STACK_SIZE
    int "LED task stack size"
    depends on LED_INDICATOR_ENABLE
    default 2048
    help
        Stack size allocated for the LED control task.

config LED_INDICATOR_TASK_PRIORITY
    int "LED task priority"
    depends on LED_INDICATOR_ENABLE
    default 5
    help
        Priority assigned to the LED control task.

endmenu
```

## components/mqtt_client/Kconfig
```kconfig
menu "MQTT Client Configuration"

config MQTT_CLIENT_ENABLE
    bool "Enable MQTT Client"
    default y
    help
        Enable or disable MQTT client functionality.

config MQTT_BROKER_URI
    string "MQTT Broker URI"
    depends on MQTT_CLIENT_ENABLE
    default "mqtt://broker.hivemq.com"
    help
        MQTT broker URI to connect to.

config MQTT_PUB_TOPIC
    string "MQTT Publish Topic"
    depends on MQTT_CLIENT_ENABLE
    default "esp32/device/data"
    help
        MQTT topic to publish device data.

endmenu
```

## components/sim4g_gps/Kconfig
```kconfig
menu "SIM4G-GPS Settings"

    config SIM4G_ENABLED
        bool "Enable SIM4G-GPS"
        default y
        help
            Enables the SIM4G-GPS component and its related features.

    config SIM_APN
        string "SIM card APN"
        default "internet"
        help
            Access Point Name (APN) for the SIM card.
            This is required for the module to connect to the cellular data network.

    config SIM4G_DEFAULT_PHONE
        string "Default phone number for SMS alerts"
        default "+84999999999"
        help
            This phone number will be used for fallback SMS alerts if none is provided at runtime.

    menu "MQTT Task Settings"
        depends on SIM4G_ENABLED

        config MQTT_TASK_STACK_SIZE
            int "Stack size for the MQTT monitoring task"
            default 4096
            help
                Stack size (in bytes) for the task that handles periodic MQTT publications.

        config MQTT_TASK_PRIORITY
            int "Priority for the MQTT monitoring task"
            default 5
            help
                Priority (0-24, with 24 being the highest) for the periodic MQTT task.

        config MQTT_PERIODIC_PUBLISH_INTERVAL_MS
            int "Interval for periodic MQTT publishing (ms)"
            default 30000
            help
                The time in milliseconds between each periodic MQTT status update.

    endmenu

    menu "Fall Alert Task Settings"
        depends on SIM4G_ENABLED

        config ALERT_TASK_STACK_SIZE
            int "Stack size for the fall alert task"
            default 4096
            help
                Stack size (in bytes) for the non-blocking task that sends fall alerts (SMS and MQTT).

        config ALERT_TASK_PRIORITY
            int "Priority for the fall alert task"
            default 5
            help
                Priority (0-24, with 24 being the highest) for the fall alert task.

    endmenu

    menu "MQTT Topic Settings"
        depends on SIM4G_ENABLED

        config MQTT_STATUS_TOPIC
            string "MQTT Periodic Status Topic"
            default "device/status"
            help
                The topic used for periodic status updates (e.g., GPS location).

        config MQTT_ALERT_TOPIC
            string "MQTT Fall Alert Topic"
            default "device/fall_alert"
            help
                The topic used for critical fall alert messages.

    endmenu

endmenu
```

## components/user_mqtt/Kconfig
```kconfig
menu "User MQTT Configuration"

config USER_MQTT_BROKER_URI
    string "MQTT Broker URI"
    default "mqtt://broker.hivemq.com"
    help
        The URI of the MQTT broker to connect to (e.g., mqtt://broker.hivemq.com).

endmenu
```

## components/wifi_connect/Kconfig
```kconfig
menu "Wi-Fi Configuration"

    config WIFI_SSID
        string "Wi-Fi SSID"
        default "ESP32_WIFI"
        help
            Network name (SSID) to connect to

    config WIFI_PASSWORD
        string "Wi-Fi Password"
        default "esp32pass"
        help
            Password for the Wi-Fi network (min 8 characters)

    config WIFI_MAX_RETRY
        int "Maximum connection retries"
        default 5
        range 1 10
        help
            Number of times to retry connecting (1-10)

    config WIFI_TIMEOUT_MS
        int "Connection timeout (milliseconds)"
        default 10000
        range 1000 30000
        help
        Used for generic operations like scanning, waiting, etc.

    config WIFI_CONNECT_TIMEOUT_MS
        int "Wi-Fi connect default timeout (ms)"
        default 30000
        help
            Used as default connection timeout in code (e.g. retry loop).

    config WIFI_AUTO_RECONNECT
        bool "Enable auto reconnect"
        default y
        help
            Automatically try to reconnect on disconnect.

endmenu
```
